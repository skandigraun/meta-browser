## meta-servo/conf/layer.conf
```bitbake
# We have a conf and classes directory, append to BBPATH
BBPATH .= ":${LAYERDIR}"

# We have a recipes directory, add to BBFILES
BBFILES += "${LAYERDIR}/recipes-*/*/*.bb ${LAYERDIR}/recipes-*/*/*.bbappend"

BBFILE_COLLECTIONS += "servo-browser-layer"
BBFILE_PATTERN_servo-browser-layer := "^${LAYERDIR}/"
BBFILE_PRIORITY_servo-browser-layer = "7"

LAYERVERSION_servo-browser-layer = "1"
LAYERSERIES_COMPAT_servo-browser-layer = "scarthgap"

LAYERDEPENDS_servo-browser-layer = "clang-layer core openembedded-layer"
```
